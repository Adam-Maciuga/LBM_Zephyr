## west.yml
```yaml
# Copyright (c) 2024 Semtech Corporation
# SPDX-License-Identifier: Apache-2.0

manifest:
  projects:
    - name: zephyr
      url: https://github.com/zephyrproject-rtos/zephyr
      revision: 81a2b95a7e78217ec0ec0173a0dc9bcc4447ea5e
      import: true

    - name: lora_basics_modem
      path: modules/lib/lora_basics_modem
      url: https://github.com/lora-net/SWL2001
      revision: v4.8.0

  self:
    path: application
```
